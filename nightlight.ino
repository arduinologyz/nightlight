/*
 * Скетч написан Arduinology
 * 
 * https://github.com/arduinologyz
 * itkudrin@gmail.com
 * 
 * Применяйте и модифицируйте свободно при условии упоминания автора и размещения ссылки https://github.com/arduinologyz.
 */
 
#include <WS2812FX.h>


//Количество светодиодов в полоске
#define LED_COUNT 8
//Куда подключается вход светодиодной полоски
#define LED_PIN 13

//Массив для хранения сменяющихся цветов
int32_t leds[LED_COUNT];

//Переменные граничных значений температур
int dark_value;

//Инициализируем библиотеку со светодиодами
WS2812FX ws2812fx = WS2812FX(LED_COUNT, LED_PIN, NEO_GRB + NEO_KHZ800);

//Пин, куда подключается вывод датчика температуры
const int lightPin = 14;

//Пин, куда подключается вывод датчика температуры
const int buttonPin = 12;

//Переменная процента смешения цветов от состояния Выключен до Включен
double percent = 0;

//Условно обозначим режимы светильника
#define MODE_AUTO1 0
#define MODE_AUTO2 1
#define MODE_ON 2
#define MODE_OFF 3

//Переменная режима работы светильника. Будем менять ее кнопкой в ходе работы.
int light_mode = MODE_AUTO1;

//Таймер кнопки
int button_timer = 100;

//Переменная, временно хранящая нажатие кнопки
bool button_pressed = false;

//Стартовая настройка системы
void setup() {

  //Зададим граничное значение темноты. В нашем датчике чем темнее, тем больше считываемое значение.


  //Темно
  dark_value = 700;

  //Обнулим значения цветов полоски
  for (int i=0;i<LED_COUNT;i++) leds[i] = BLACK;

  //Запускаем библиотеку светодиодов
  ws2812fx.init();
  //Зададим максимальную яркость. Абсолютный максимум 255, комфортный для глаз 100. Поэкспериментируйте.
  ws2812fx.setBrightness(255);
  

  //Стартуем возможность выводить информацию с системы на UART (и далее через последовательный порт в подключенный компьютер)
  Serial.begin(115200);

  //Установим режим пина, к которому подключена кнопка, как вход
  pinMode(buttonPin,INPUT);
    //Сенсорная кнопка выдает true, когда нажата, а обычная - "прижимает" ногу к земле, 
    //поэтому для нее нужно настроить ногу как INPUT_PULLUP (вход с подтяжкой) вместо INPUT 
   
  //Установим пин датчика температуры на вход
  pinMode(lightPin,INPUT);
}

void loop() {

  //Сделаем задержку в чтении состояния кнопки для исключения явления "дребезга" для уверенного срабатывания
  if (button_timer>0) button_timer--;

  //Когда таймер кнопки обнулится, считаем ее
  if (button_timer==0){
    button_timer = 100;
    //Сенсорная кнопка выдает true, когда нажата, а обычная - "прижимает" ногу к земле, 
    //поэтому для нее нужно настроить ногу как INPUT_PULLUP (вход с подтяжкой) вместо INPUT 
    
    if (digitalRead(buttonPin)==true) button_pressed = true;
  }

  //Если кнопка нажата, циклически меняем режим работы светильника от MODE_AUTO1 до MODE_OFF
  if (button_pressed){
    if (light_mode<MODE_OFF) light_mode++; else light_mode = 0;
    button_pressed = false;
  }

  //Считsываем значение температуры
  int light = analogRead(lightPin);
  
  //Компоненты цветов для смешения в процентном сотношении
  uint8_t r1,r2,r3,g1,g2,g3,b1,b2,b3;

  //Процент для смешения цветов будем плавно увеличивать, если темно (т.е. значение с датчика освещенности больше заданного критического порога)
  if (light>dark_value){
     if (percent<100) percent += 0.2;
  } else {
    //А если светло, плавно гасим светильник. 
    //Не забываем держать процент свечения в диапазоне 0..100
    if (percent>0.2) percent -= 0.2;
  }

  //Начальный цвет всегда черный
  r1 = 0; g1 = 0; b1 = 0;

  //Установим второй цвет для смешения в зависимости от режима
  if (light_mode==MODE_AUTO1) {
    //Для режима MODE_AUTO1 установим теплый белый
    r2 = 255; g2 = 220; b2 = 150;
  }
  if (light_mode==MODE_AUTO2) {
    //Для режима MODE_AUTO2 установим синий цвет с уклоном в бирюзовый. 
    //Меняйте компоненты цветов от 0 до 255, чтобы получить разные цвета! Экспериментируйте!
    r2 = 0; g2 = 50; b2 = 255;
  }
  if (light_mode==MODE_ON){
    //Для режима MODE_ON (включено постоянно) установим теплый белый цвет. Поменяйте его!
     r2 = 255; g2 = 220; b2 = 150;
     percent = 100;
  }
  if (light_mode==MODE_OFF){
    //Для режима MODE_OFF (выключено постоянно) достаточно установить процент второго цвета в ноль, итогом будет всегда черный
     percent = 0;
  }
     
  //Рассчитаем компоненты итогового цвета
  r3 = ((double)100-percent)*r1/100 + (double)percent*r2/100;
  g3 = ((double)100-percent)*g1/100 + (double)percent*g2/100;
  b3 = ((double)100-percent)*b1/100 + (double)percent*b2/100;

  //Запишем получившийся цвет в массив
  for (int i=0;i<LED_COUNT;i++) leds[i] = ws2812fx.Color(r3,g3,b3);;


  //Запишем значения в светодиодную ленту
  for (int i=0;i<LED_COUNT;i++) ws2812fx.setPixelColor(i,leds[i]);

  //Покажем цвета
  ws2812fx.show();
  ws2812fx.service();
  
  //Выведем информацию о значении освещенности  на подключенный компьютер
  Serial.println(light);


  //Обеспечим задержку в 0.002 секунды для плавности перехода
  delay(2);
}
